## firmware/main/Kconfig.projbuild
```kconfig
menu "Vibration Node (Mancal)"

    menu "Pinagem SPI / INT1 do sensor"
        config VIB_PIN_SCLK
            int "GPIO SCLK (SPC do sensor)"
            default 18
        config VIB_PIN_MOSI
            int "GPIO MOSI (SDI/SDA do sensor)"
            default 23
        config VIB_PIN_MISO
            int "GPIO MISO (SDO/SA0 do sensor)"
            default 19
        config VIB_PIN_CS
            int "GPIO CS do sensor"
            default 5
        config VIB_PIN_INT1
            int "GPIO ligada ao INT1 do sensor"
            default 4
        config VIB_SPI_CLOCK_HZ
            int "Clock SPI maximo (Hz) — ICM-20948 fica limitado a 7 MHz"
            range 1000000 10000000
            default 8000000
    endmenu

    menu "Identificacao do no"
        config VIB_NODE_ID_FORCED
            int "ID do mancal forcado (0 = automatico pelo pino de selecao)"
            range 0 2
            default 0
            help
                0: le o pino VIB_PIN_NODE_SEL (pull-up interno).
                   Pino aberto  -> MANCAL_1
                   Pino em GND  -> MANCAL_2
                1 ou 2: ignora o pino e usa esse ID fixo.
        config VIB_PIN_NODE_SEL
            int "GPIO de selecao do mancal (jumper para GND = MANCAL_2)"
            default 27
    endmenu

    menu "Sensor"
        choice VIB_SENSOR
            prompt "Modelo do acelerometro"
            default VIB_SENSOR_AUTO
            help
                Automatico: identifica o chip pelo registrador de ID
                (LSM6DS3 0x69, LSM6DS3TR-C 0x6A, BMI160 0xD1, ICM-20948 0xEA).
                Escolher um modelo fixo so faz o firmware recusar outro chip.
            config VIB_SENSOR_AUTO
                bool "Automatico (recomendado)"
            config VIB_SENSOR_LSM6DS3
                bool "LSM6DS3 / LSM6DS3TR-C (6660 Hz, banda 3160 Hz)"
            config VIB_SENSOR_BMI160
                bool "BMI160 (1600 Hz, banda 684 Hz)"
            config VIB_SENSOR_ICM20948
                bool "ICM-20948 (4500 Hz, banda 1209 Hz)"
        endchoice
        config VIB_SENSOR_TYPE
            int
            default 0 if VIB_SENSOR_AUTO
            default 1 if VIB_SENSOR_LSM6DS3
            default 3 if VIB_SENSOR_BMI160
            default 4 if VIB_SENSOR_ICM20948

        choice VIB_FS
            prompt "Fundo de escala do acelerometro"
            default VIB_FS_8G
            config VIB_FS_4G
                bool "+/- 4 g"
            config VIB_FS_8G
                bool "+/- 8 g"
            config VIB_FS_16G
                bool "+/- 16 g"
        endchoice
        config VIB_FS_G
            int
            default 4 if VIB_FS_4G
            default 8 if VIB_FS_8G
            default 16 if VIB_FS_16G

        choice VIB_WTM
            prompt "Amostras por pacote / watermark da FIFO (XYZ)"
            default VIB_WTM_512
            config VIB_WTM_512
                bool "512 amostras (~77 ms a 6,66 kHz)"
            config VIB_WTM_1024
                bool "1024 amostras (~154 ms) — so LSM6DS3 original usa como watermark"
        endchoice
        config VIB_WTM_SAMPLES
            int
            default 512 if VIB_WTM_512
            default 1024 if VIB_WTM_1024
    endmenu

    menu "Alarme local (FFT no ESP32)"
        config VIB_PIN_BUZZER
            int "GPIO do buzzer (-1 = sem buzzer)"
            default 25
        config VIB_BUZZER_PASSIVE
            bool "Buzzer passivo (gera o tom por PWM)"
            default y
            help
                Passivo: o ESP32 gera a frequencia (LEDC). Funciona tambem com a
                maioria dos buzzers ativos. Desmarque para um buzzer ativo ligado
                por transistor (nivel alto = toca).
        config VIB_BUZZER_FREQ_HZ
            int "Frequencia do tom (Hz)"
            depends on VIB_BUZZER_PASSIVE
            default 2700
        config VIB_PIN_TRIP
            int "GPIO da saida de parada do motor (-1 = sem saida)"
            default 26
            help
                Liga a um modulo rele ou optoacoplador que atua na entrada de
                parada/habilitacao do inversor. NUNCA acione a carga do motor
                diretamente. A saida so e usada se 'trip_output' for habilitado
                na configuracao enviada pelo PC (desligado por padrao).
        config VIB_TRIP_ACTIVE_HIGH
            bool "Nivel ALTO = parar o motor"
            default y
            help
                Sim: a saida fica em 0 V com o motor liberado e vai a 3,3 V para parar.
                Nao (fail-safe): a saida fica em 3,3 V com o motor liberado e vai a
                0 V para parar. Assim, ESP32 desligado ou cabo solto tambem param
                o motor (rele energizado = motor liberado). E a opcao recomendada
                depois que os limites estiverem validados.
        config VIB_PIN_ACK_BUTTON
            int "GPIO do botao de reconhecimento (-1 = sem botao)"
            default 0
            help
                Padrao: botao BOOT da placa (GPIO0). Um toque silencia o buzzer e
                rearma a parada travada (se a vibracao ja voltou ao normal).
    endmenu

    menu "Link USB-Serial"
        config VIB_UART_BAUD
            int "Baud rate da UART0 (USB)"
            default 921600
            help
                Taxa de dados util: ~40 kB/s (6660 amostras/s x 6 bytes).
                921600 bps (~92 kB/s) e suficiente e funciona com CP2102/CH340.
                2000000 bps da mais folga (verifique se a ponte USB da placa suporta).
        config VIB_STATUS_PERIOD_MS
            int "Periodo do pacote de status/heartbeat (ms)"
            default 1000
    endmenu

endmenu
```
